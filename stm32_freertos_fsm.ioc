# file: stm32_freertos_fsm.ioc
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FREERTOS.Queues01=stateQueue,16,uint16_t,0,Static,stateQueueBuffer,stateQueueControlBlock
FREERTOS.Tasks01=TaskBlinkShort,16,128,fTaskBlinkShort,Default,NULL,Static,TaskBlinkShortBuffer,TaskBlinkShortControlBlock;TaskBlinkLong,17,128,fTaskBlinkLong,Default,NULL,Static,TaskBlinkLongBuffer,TaskBlinkLongControlBlock;TaskRealBlink,40,128,fTaskRealBlink,Default,NULL,Static,TaskRealBlinkBuffer,TaskRealBlinkControlBlock;TaskHandlerFSM,48,128,fTaskHandlerFSM,Default,NULL,Static,TaskHandlerFSMBuffer,TaskHandlerFSMControlBlock;TaskDelayBlink,41,128,fTaskDelayBlink,Default,NULL,Static,TaskDelayBlinkBuffer,TaskDelayBlinkControlBlock
Mcu.Family=STM32F1
Mcu.Name=STM32F103C(8-B)Tx
Mcu.Package=LQFP48
NVIC.PriorityGroup=NVIC_PRIORITYGROUP_4
NVIC.TIM1_UP_IRQn=true\:15\:0\:false\:false\:true\:false\:false\:true\:true
NVIC.TimeBase=TIM1_UP_IRQn
NVIC.TimeBaseIP=TIM1
PA13.Mode=Trace_Asynchronous_SW
PA13.Signal=SYS_JTMS-SWDIO
PA14.Mode=Trace_Asynchronous_SW
PA14.Signal=SYS_JTCK-SWCLK
PB3.Mode=Trace_Asynchronous_SW
PB3.Signal=SYS_JTDO-TRACESWO
PC13-TAMPER-RTC.Signal=GPIO_Output
ProjectManager.HeapSize=0x200
ProjectManager.StackSize=0x400
ProjectManager.TargetToolchain=STM32CubeIDE
RCC.APB1Freq_Value=8000000
RCC.APB2Freq_Value=8000000
VP_FREERTOS_VS_CMSIS_V2.Mode=CMSIS_V2
VP_SYS_VS_tim1.Mode=TIM1
board=custom

// file: Core/Src/main.c
/* USER CODE BEGIN Header */
/**
  ******************************************************************************
  * @file           : main.c
  * @brief          : Main program body
  ******************************************************************************
  * @attention
  *
  * Copyright (c) 2024 STMicroelectronics.
  * All rights reserved.
  *
  * This software is licensed under terms that can be found in the LICENSE file
  * in the root directory of this software component.
  * If no LICENSE file comes with this software, it is provided AS-IS.
  *
  ******************************************************************************
  */
/* USER CODE END Header */
#include "main.h"
#include "cmsis_os.h"

/* USER CODE BEGIN Includes */
#include"queue.h"
/* USER CODE END Includes */

typedef StaticTask_t osStaticThreadDef_t;
typedef StaticQueue_t osStaticMessageQDef_t;

/* Definitions for TaskBlinkShort */
osThreadId_t TaskBlinkShortHandle;
uint32_t TaskBlinkShortBuffer[ 128 ];
osStaticThreadDef_t TaskBlinkShortControlBlock;
const osThreadAttr_t TaskBlinkShort_attributes = {
  .name = "TaskBlinkShort",
  .cb_mem = &TaskBlinkShortControlBlock,
  .cb_size = sizeof(TaskBlinkShortControlBlock),
  .stack_mem = &TaskBlinkShortBuffer[0],
  .stack_size = sizeof(TaskBlinkShortBuffer),
  .priority = (osPriority_t) osPriorityBelowNormal,
};
/* Definitions for TaskBlinkLong */
osThreadId_t TaskBlinkLongHandle;
uint32_t TaskBlinkLongBuffer[ 128 ];
osStaticThreadDef_t TaskBlinkLongControlBlock;
const osThreadAttr_t TaskBlinkLong_attributes = {
  .name = "TaskBlinkLong",
  .cb_mem = &TaskBlinkLongControlBlock,
  .cb_size = sizeof(TaskBlinkLongControlBlock),
  .stack_mem = &TaskBlinkLongBuffer[0],
  .stack_size = sizeof(TaskBlinkLongBuffer),
  .priority = (osPriority_t) osPriorityBelowNormal1,
};
/* Definitions for TaskRealBlink */
osThreadId_t TaskRealBlinkHandle;
uint32_t TaskRealBlinkBuffer[ 128 ];
osStaticThreadDef_t TaskRealBlinkControlBlock;
const osThreadAttr_t TaskRealBlink_attributes = {
  .name = "TaskRealBlink",
  .cb_mem = &TaskRealBlinkControlBlock,
  .cb_size = sizeof(TaskRealBlinkControlBlock),
  .stack_mem = &TaskRealBlinkBuffer[0],
  .stack_size = sizeof(TaskRealBlinkBuffer),
  .priority = (osPriority_t) osPriorityHigh,
};
/* Definitions for TaskHandlerFSM */
osThreadId_t TaskHandlerFSMHandle;
uint32_t TaskHandlerFSMBuffer[ 128 ];
osStaticThreadDef_t TaskHandlerFSMControlBlock;
const osThreadAttr_t TaskHandlerFSM_attributes = {
  .name = "TaskHandlerFSM",
  .cb_mem = &TaskHandlerFSMControlBlock,
  .cb_size = sizeof(TaskHandlerFSMControlBlock),
  .stack_mem = &TaskHandlerFSMBuffer[0],
  .stack_size = sizeof(TaskHandlerFSMBuffer),
  .priority = (osPriority_t) osPriorityRealtime,
};
/* Definitions for TaskDelayBlink */
osThreadId_t TaskDelayBlinkHandle;
uint32_t TaskDelayBlinkBuffer[ 128 ];
osStaticThreadDef_t TaskDelayBlinkControlBlock;
const osThreadAttr_t TaskDelayBlink_attributes = {
  .name = "TaskDelayBlink",
  .cb_mem = &TaskDelayBlinkControlBlock,
  .cb_size = sizeof(TaskDelayBlinkControlBlock),
  .stack_mem = &TaskDelayBlinkBuffer[0],
  .stack_size = sizeof(TaskDelayBlinkBuffer),
  .priority = (osPriority_t) osPriorityHigh1,
};
/* Definitions for stateQueue */
osMessageQueueId_t stateQueueHandle;
uint8_t stateQueueBuffer[ 16 * sizeof( uint16_t ) ];
osStaticMessageQDef_t stateQueueControlBlock;
const osMessageQueueAttr_t stateQueue_attributes = {
  .name = "stateQueue",
  .cb_mem = &stateQueueControlBlock,
  .cb_size = sizeof(stateQueueControlBlock),
  .mq_mem = &stateQueueBuffer,
  .mq_size = sizeof(stateQueueBuffer)
};
/* USER CODE BEGIN PV */
// Определение перечисления для состояний конечного автомата
typedef enum {
    STATE_1,
    STATE_2,
    STATE_3
} State_t;
/* USER CODE END PV */

void SystemClock_Config(void);
static void MX_GPIO_Init(void);
void fTaskBlinkShort(void *argument);
void fTaskBlinkLong(void *argument);
void fTaskRealBlink(void *argument);
void fTaskHandlerFSM(void *argument);
void fTaskDelayBlink(void *argument);

int main(void)
{

  /* MCU Configuration--------------------------------------------------------*/

  /* Reset of all peripherals, Initializes the Flash interface and the Systick. */
  HAL_Init();

  /* Configure the system clock */
  SystemClock_Config();

  /* Initialize all configured peripherals */
  MX_GPIO_Init();

  /* Init scheduler */
  osKernelInitialize();

  /* Create the queue(s) */
  /* creation of stateQueue */
  stateQueueHandle = osMessageQueueNew (16, sizeof(uint16_t), &stateQueue_attributes);

  /* Create the thread(s) */
  /* creation of TaskBlinkShort */
  TaskBlinkShortHandle = osThreadNew(fTaskBlinkShort, NULL, &TaskBlinkShort_attributes);

  /* creation of TaskBlinkLong */
  TaskBlinkLongHandle = osThreadNew(fTaskBlinkLong, NULL, &TaskBlinkLong_attributes);

  /* creation of TaskRealBlink */
  TaskRealBlinkHandle = osThreadNew(fTaskRealBlink, NULL, &TaskRealBlink_attributes);

  /* creation of TaskHandlerFSM */
  TaskHandlerFSMHandle = osThreadNew(fTaskHandlerFSM, NULL, &TaskHandlerFSM_attributes);

  /* creation of TaskDelayBlink */
  TaskDelayBlinkHandle = osThreadNew(fTaskDelayBlink, NULL, &TaskDelayBlink_attributes);

  /* USER CODE BEGIN RTOS_THREADS */
  /* add threads, ... */
  /* Удаление TaskBlinkShort */
  osThreadTerminate(TaskBlinkShortHandle);

  /* Удаление TaskBlinkLong */
  osThreadTerminate(TaskBlinkLongHandle);

  /* Удаление TaskRealBlink */
  osThreadTerminate(TaskRealBlinkHandle);

  /* Удаление TaskDelayBlink */
  osThreadTerminate(TaskDelayBlinkHandle);
  /* USER CODE END RTOS_THREADS */

  /* Start scheduler */
  osKernelStart();

  /* We should never get here as control is now taken by the scheduler */
  /* Infinite loop */
  while (1)
  {

  }
}

void SystemClock_Config(void)
{
  RCC_OscInitTypeDef RCC_OscInitStruct = {0};
  RCC_ClkInitTypeDef RCC_ClkInitStruct = {0};

  /** Initializes the RCC Oscillators according to the specified parameters
  * in the RCC_OscInitTypeDef structure.
  */
  RCC_OscInitStruct.OscillatorType = RCC_OSCILLATORTYPE_HSI;
  RCC_OscInitStruct.HSIState = RCC_HSI_ON;
  RCC_OscInitStruct.HSICalibrationValue = RCC_HSICALIBRATION_DEFAULT;
  RCC_OscInitStruct.PLL.PLLState = RCC_PLL_NONE;
  if (HAL_RCC_OscConfig(&RCC_OscInitStruct) != HAL_OK)
  {
    Error_Handler();
  }

  /** Initializes the CPU, AHB and APB buses clocks
  */
  RCC_ClkInitStruct.ClockType = RCC_CLOCKTYPE_HCLK|RCC_CLOCKTYPE_SYSCLK
                              |RCC_CLOCKTYPE_PCLK1|RCC_CLOCKTYPE_PCLK2;
  RCC_ClkInitStruct.SYSCLKSource = RCC_SYSCLKSOURCE_HSI;
  RCC_ClkInitStruct.AHBCLKDivider = RCC_SYSCLK_DIV1;
  RCC_ClkInitStruct.APB1CLKDivider = RCC_HCLK_DIV1;
  RCC_ClkInitStruct.APB2CLKDivider = RCC_HCLK_DIV1;

  if (HAL_RCC_ClockConfig(&RCC_ClkInitStruct, FLASH_LATENCY_0) != HAL_OK)
  {
    Error_Handler();
  }
}

static void MX_GPIO_Init(void)
{
  GPIO_InitTypeDef GPIO_InitStruct = {0};

  /* GPIO Ports Clock Enable */
  __HAL_RCC_GPIOC_CLK_ENABLE();
  __HAL_RCC_GPIOA_CLK_ENABLE();
  __HAL_RCC_GPIOB_CLK_ENABLE();

  /*Configure GPIO pin Output Level */
  HAL_GPIO_WritePin(GPIOC, GPIO_PIN_13, GPIO_PIN_RESET);

  /*Configure GPIO pin : PC13 */
  GPIO_InitStruct.Pin = GPIO_PIN_13;
  GPIO_InitStruct.Mode = GPIO_MODE_OUTPUT_PP;
  GPIO_InitStruct.Pull = GPIO_NOPULL;
  GPIO_InitStruct.Speed = GPIO_SPEED_FREQ_LOW;
  HAL_GPIO_Init(GPIOC, &GPIO_InitStruct);

}

void fTaskBlinkShort(void *argument)
{
  /* USER CODE BEGIN 5 */
	const uint32_t xFrequency = 500; // 500 миллисекунд
	    const TickType_t xTransitionTime = pdMS_TO_TICKS(6000); // 6 секунд

	    TickType_t xLastWakeTime = xTaskGetTickCount();
  /* Infinite loop */
  for(;;)
  {
	  HAL_GPIO_TogglePin(GPIOC, GPIO_PIN_13); // Выполнение действий для состояния 1
	         osDelay(xFrequency); // Задержка в тиках времени FreeRTOS
	         if ((xTaskGetTickCount() - xLastWakeTime) >= xTransitionTime) {
	             // Отправка сообщения о переходе в состояние 1
	        	 State_t currentState = STATE_2;
	             xQueueSend(stateQueueHandle, &currentState, portMAX_DELAY);
	             vTaskDelete(NULL); // Завершение задачи
	         }
  }
  /* USER CODE END 5 */
}

void fTaskBlinkLong(void *argument)
{
  /* USER CODE BEGIN fTaskBlinkLong */
	const uint32_t xFrequency = 1000; // 500 миллисекунд
	    const TickType_t xTransitionTime = pdMS_TO_TICKS(6000); // 6 секунд

	    TickType_t xLastWakeTime = xTaskGetTickCount();
  /* Infinite loop */
  for(;;)
  {
	  HAL_GPIO_TogglePin(GPIOC, GPIO_PIN_13); // Выполнение действий для состояния 1
	         osDelay(xFrequency); // Задержка в тиках времени FreeRTOS
	         if ((xTaskGetTickCount() - xLastWakeTime) >= xTransitionTime) {
	             // Отправка сообщения о переходе в состояние 1
	        	 State_t currentState = STATE_1;
	        	 	             xQueueSend(stateQueueHandle, &currentState, portMAX_DELAY);
	             vTaskDelete(NULL); // Завершение задачи
	         }
  }
  /* USER CODE END fTaskBlinkLong */
}

void fTaskRealBlink(void *argument)
{
  /* USER CODE BEGIN fTaskRealBlink */
	const uint32_t xFrequency = 100; // 500 миллисекунд
	    const TickType_t xTransitionTime = pdMS_TO_TICKS(2000); // 6 секунд

	    TickType_t xLastWakeTime = xTaskGetTickCount();
  /* Infinite loop */
  for(;;)
  {
	  HAL_GPIO_TogglePin(GPIOC, GPIO_PIN_13); // Выполнение действий для состояния 1
	         osDelay(xFrequency); // Задержка в тиках времени FreeRTOS
	         if ((xTaskGetTickCount() - xLastWakeTime) >= xTransitionTime) {
	             // Отправка сообщения о переходе в состояние 1
	            // xQueueSend(stateQueueHandle, &STATE_1, portMAX_DELAY);
	             vTaskDelete(NULL); // Завершение задачи
	         }
  }
  /* USER CODE END fTaskRealBlink */
}

void fTaskHandlerFSM(void *argument)
{
  /* USER CODE BEGIN fTaskHandlerFSM */
	TaskDelayBlinkHandle = osThreadNew(fTaskDelayBlink, NULL, &TaskDelayBlink_attributes);
	TaskBlinkShortHandle = osThreadNew(fTaskBlinkShort, NULL, &TaskBlinkShort_attributes);
	State_t currentState = STATE_1;
	//xTaskCreate(fTaskDelayBlink, "StateDelayBlink", configMINIMAL_STACK_SIZE, NULL, tskIDLE_PRIORITY + 1, NULL);
  /* Infinite loop */
  for(;;)
  {
	  // Ожидание сообщения о переходе в другое состояние
	         xQueueReceive(stateQueueHandle, &currentState, portMAX_DELAY);
	                // Выбор и запуск задачи для нового состояния
	                switch (currentState) {
	                    case STATE_1:
	                    	TaskBlinkShortHandle = osThreadNew(fTaskBlinkShort, NULL, &TaskBlinkShort_attributes);
	                        break;
	                    case STATE_2:
	                    	TaskBlinkLongHandle = osThreadNew(fTaskBlinkLong, NULL, &TaskBlinkLong_attributes);
	                        break;
	                    case STATE_3:
	                    	TaskRealBlinkHandle = osThreadNew(fTaskRealBlink, NULL, &TaskRealBlink_attributes);
	                        break;
	                    default:
	                        break;
	                }
  }
  /* USER CODE END fTaskHandlerFSM */
}

void fTaskDelayBlink(void *argument)
{
  /* USER CODE BEGIN fTaskDelayBlink */
    const uint32_t xTaskDelayTime = 8000; // 8 секунд
  /* Infinite loop */
  for(;;)
  {
	 osDelay(xTaskDelayTime);
	 State_t currentState = STATE_3;
	 	             xQueueSend(stateQueueHandle, &currentState, portMAX_DELAY);
  }
  /* USER CODE END fTaskDelayBlink */
}

void HAL_TIM_PeriodElapsedCallback(TIM_HandleTypeDef *htim)
{
  if (htim->Instance == TIM1) {
    HAL_IncTick();
  }
}

void Error_Handler(void)
{
  __disable_irq();
  while (1)
  {
  }
}
